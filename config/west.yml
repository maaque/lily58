## config/west.yml
```yaml
manifest:
  remotes:
    - name: zmkfirmware
      url-base: https://github.com/zmkfirmware
    - name: locales
      url-base: https://github.com/joelspadin
  projects:
    - name: zmk
      remote: zmkfirmware
      revision: v0.3
      import: app/west.yml
    - name: zmk-locales
      remote: locales
      revision: v1.1.0
  self:
    path: config
```
